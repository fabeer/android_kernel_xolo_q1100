/* Copyright (c) 2013, The Linux Foundation. All rights reserved.
 *
 * This program is free software; you can redistribute it and/or modify
 * it under the terms of the GNU General Public License version 2 and
 * only version 2 as published by the Free Software Foundation.
 *
 * This program is distributed in the hope that it will be useful,
 * but WITHOUT ANY WARRANTY; without even the implied warranty of
 * MERCHANTABILITY or FITNESS FOR A PARTICULAR PURPOSE.  See the
 * GNU General Public License for more details.
 */

/*---------------------------------------------------------------------------
 * This file is autogenerated file using gcdb parser. Please do not edit it.
 * Update input XML file to add a new entry or update variable in this file
 * VERSION = "1.0"
 *---------------------------------------------------------------------------*/
&mdss_mdp {
	        dsi_r6331_1080_vid: qcom,mdss_dsi_r63311_1080p_video {
		qcom,mdss-dsi-panel-name = "r6331 bw905 chaosheng 1080p video mode dsi panel";
		qcom,mdss-dsi-panel-controller = <&mdss_dsi0>;
		qcom,mdss-dsi-panel-type = "dsi_video_mode";
		qcom,mdss-dsi-panel-destination = "display_1";
		qcom,mdss-dsi-panel-framerate = <60>;
		qcom,mdss-dsi-virtual-channel-id = <0>;
		qcom,mdss-dsi-stream = <0>;
		qcom,mdss-dsi-panel-width = <1080>;
		qcom,mdss-dsi-panel-height = <1920>;
		qcom,mdss-dsi-h-front-porch = <70>;
		qcom,mdss-dsi-h-back-porch = <37>;
		qcom,mdss-dsi-h-pulse-width = <8>;
		qcom,mdss-dsi-h-sync-skew = <0>;
		qcom,mdss-dsi-v-back-porch = <2>;
		qcom,mdss-dsi-v-front-porch = <2>;
		qcom,mdss-dsi-v-pulse-width = <4>;
		qcom,mdss-dsi-h-left-border = <0>;
		qcom,mdss-dsi-h-right-border = <0>;
		qcom,mdss-dsi-v-top-border = <0>;
		qcom,mdss-dsi-v-bottom-border = <0>;
		qcom,mdss-dsi-bpp = <24>;
		qcom,mdss-dsi-color-order = <0>;
		qcom,mdss-dsi-underflow-color = <0xff>;
		qcom,mdss-dsi-border-color = <0>;
		qcom,mdss-dsi-pixel-packing = <0>;
		qcom,mdss-dsi-on-command = [                           
		29 01 00 00 00 00 02 B0 04                           
		29 01 00 00 00 00 01 00                           
		29 01 00 00 00 00 01 00                           
		29 01 00 00 00 00 02 D6 01                           
		29 01 00 00 00 00 03 51 0F FF                           
		29 01 00 00 00 00 02 53 04                           
		29 01 00 00 00 00 02 55 02                           
		29 01 00 00 00 00 07 B3 14 00 00 00 00 00                           
		29 01 00 00 00 00 03 B4 0C 00                           
		29 01 00 00 00 00 03 B6 3A c3                           
		29 01 00 00 00 00 02 B7 00                           
		29 01 00 00 00 00 08 B9 0F 18 04 40 9F 1F 80                           
		29 01 00 00 00 00 08 BA 0F 18 04 40 9F 1F D7                           
		29 01 00 00 00 00 23 C1 84 60 40 EB FF 6F CE FF FF 0F 01 58 73 AE 31 20 C6 FF FF 1F F3 FF 5F 10 10 10 10 00 00 00 22 02 02 00
		29 01 00 00 00 00 08 C2 31 F7 80 10 08 00 00                           
		29 01 00 00 00 00 04 C3 01 00 00                           
		29 01 00 00 00 00 17 C4 70 00 00 00 00 04 00 03 00 0C 06 00 00 00 00 00 04 00 03 00 0C 06
		29 01 00 00 00 00 29 C6 00 79 00 79 00 79 00 00 00 00 00 79 00 79 00 79 10 19 07 00 01 00 79 00 79 00 79 00 00 00 00 00 79 00 79 00 79 10 19 07
		29 01 00 00 00 00 19 C7 00 0F 1A 23 30 48 3F 50 5C 69 6F 72 00 0F 1A 23 30 48 3F 50 5C 69 6F 72
		29 01 00 00 00 00 19 C8 00 0F 19 23 2F 48 3F 50 5C 68 6B 70 00 0F 19 23 2F 49 3F 50 5C 68 6B 70
		29 01 00 00 00 00 19 C9 00 0F 1A 22 2F 48 3F 51 5F 67 6B 70 00 0F 1A 22 2F 48 3F 51 5F 67 6B 70
		29 01 00 00 00 00 21 CA 00 80 80 80 80 80 80 80 08 20 80 80 0A 4A 37 A0 55 F8 0C 0C 20 10 3F 3F 00 00 10 10 3F 3F 3F 3F
		29 01 00 00 00 00 0a CB 31 FC 3F 8C 00 00 00 00 C0                     
		29 01 00 00 00 00 02 CC 09                           
		29 01 00 00 00 00 04 CD 00 00 FF                           
		29 01 00 00 00 00 08 CE 00 06 08 C1 00 1E 04                           
		29 01 00 00 00 00 06 CF 00 00 C1 05 3F
		29 01 00 00 00 00 0f D0 00 00 19 18 99 99 19 01 89 00 55 19 99 01
		29 01 00 00 00 00 1e D1 20 00 00 04 08 0C 10 00 00 00 00 00 3C 04 20 00 00 04 08 0C 10 00 00 3C 05 40 00 32 31
		29 01 00 00 00 00 04 D2 5C 00 00
		29 01 00 00 00 00 1b D3 1B 33 BB CC C4 33 33 33 00 01 00 A0 D8 A0 0D 41 33 44 22 70 02 41 03 3D BF 00
		29 01 00 00 00 00 08 D5 06 00 00 01 29 01 29
		29 01 00 00 00 00 08 D5 06 00 00 01 29 01 29
		29 01 00 00 00 00 15 D7 84 E0 7F A8 CE 38 FC C1 83 E7 8F 1F 3C 10 FA C3 0F 04 41 00
		29 01 00 00 00 00 07 D8 00 80 80 40 42 14
		29 01 00 00 00 00 03 D9 00 00
		29 01 00 00 00 00 03 DD 10 8C
		29 01 00 00 00 00 07 DE 00 FF 07 10 00 73
		29 01 00 00 00 00 02 36 00 
		29 01 00 00 00 00 02 3a 55	
		05 01 00 00 ff 00 02 29 00
		05 01 00 00 20 00 02 11 00];
		qcom,mdss-dsi-off-command = [05 01 00 00 32 00 02 28 00
					05 01 00 00 78 00 02 10 00];
		qcom,mdss-dsi-on-command-state = "dsi_lp_mode";
		qcom,mdss-dsi-off-command-state = "dsi_hs_mode";
		qcom,mdss-dsi-h-sync-pulse = <1>;
		qcom,mdss-dsi-traffic-mode = <2>;
		qcom,mdss-dsi-lane-map = <0>;
		qcom,mdss-dsi-bllp-eof-power-mode;
		qcom,mdss-dsi-bllp-power-mode;
		qcom,mdss-dsi-lane-0-state;
		qcom,mdss-dsi-lane-1-state;
		qcom,mdss-dsi-lane-2-state;
		qcom,mdss-dsi-lane-3-state;
		qcom,mdss-dsi-panel-timings = [bc 3e 34 00 55 52 33 40 50 03 04 00];
		qcom,mdss-dsi-t-clk-post = <0x20>;
		qcom,mdss-dsi-t-clk-pre = <0x2D>;
		qcom,mdss-dsi-bl-min-level = <1>;
		qcom,mdss-dsi-bl-max-level = <255>;
		qcom,mdss-dsi-dma-trigger = <4>;
		qcom,mdss-dsi-mdp-trigger = <0>;
		qcom,mdss-pan-bl-levels = <1 255>;
		qcom,mdss-dsi-bl-pmic-control-type = "bl_ctrl_wled";

	};
};
