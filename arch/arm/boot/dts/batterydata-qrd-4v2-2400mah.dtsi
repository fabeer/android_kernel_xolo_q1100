/* Copyright (c) 2013, The Linux Foundation. All rights reserved.
 *
 * This program is free software; you can redistribute it and/or modify
 * it under the terms of the GNU General Public License version 2 and
 * only version 2 as published by the Free Software Foundation.
 *
 * This program is distributed in the hope that it will be useful,
 * but WITHOUT ANY WARRANTY; without even the implied warranty of
 * MERCHANTABILITY or FITNESS FOR A PARTICULAR PURPOSE.  See the
 * GNU General Public License for more details.
 */

qcom,qrd-4v2-2400mah-data {
	qcom,fcc-mah = <2400>;
	qcom,default-rbatt-mohm = <146>;
	qcom,rbatt-capacitive-mohm = <0>;
	qcom,flat-ocv-threshold-uv = <3800000>;
	qcom,max-voltage-uv = <4200000>;
	qcom,v-cutoff-uv = <3400000>;
	qcom,chg-term-ua = <100000>;
	qcom,batt-id-kohm = <47>;

	qcom,rbatt-sf-lut {
		qcom,lut-col-legend = <(-20) 0 25 40 60>;
		qcom,lut-row-legend = <100 95 90 85 80>,
				<75 70 65 60 55>,
				<50 45 40 35 30>,
				<25 20 15 10 9>,
				<8 7 6 5 4>,
				<3 2 1 0>;
		qcom,lut-data = <904 234 100 85 80>,
				<905 234 100 85 80>,
				<934 244 102 86 81>,
				<928 254 105 87 82>,
				<933 268 109 89 84>,
				<924 280 114 91 85>,
				<913 283 123 96 88>,
				<916 267 135 103 91>,
				<930 252 137 110 95>,
				<954 247 117 106 95>,
				<990 247 103 88 85>,
				<1036 253 104 86 84>,
				<1101 264 108 89 85>,
				<1211 286 112 93 88>,
				<1366 340 120 95 87>,
				<1601 394 128 95 87>,
				<2178 402 128 97 89>,
				<5419 423 126 97 89>,
				<10789 528 128 97 91>,
				<13463 589 132 100 91>,
				<17695 678 137 102 92>,
				<23046 814 145 104 93>,
				<30725 1019 153 106 93>,
				<41382 1359 156 106 93>,
				<56311 1959 165 108 95>,
				<77209 3523 189 117 99>,
				<104609 6039 235 127 105>,
				<138858 9711 352 141 112>,
				<165825 15373 1069 246 226>;
	};

	qcom,fcc-temp-lut {
		qcom,lut-col-legend = <(-20) 0 25 40 60>;
		qcom,lut-data = <2459 2468 2473 2461 2459>;
	};

	qcom,pc-temp-ocv-lut {
		qcom,lut-col-legend = <(-20) 0 25 40 60>;
		qcom,lut-row-legend = <100 95 90 85 80>,
				<75 70 65 60 55>,
				<50 45 40 35 30>,
				<25 20 15 10 9>,
				<8 7 6 5 4>,
				<3 2 1 0>;
		qcom,lut-data = 
		             	<4173 4177 4173 4170 4170>,
				<4124 4127 4128 4122 4124>,
				<4077 4082 4079 4071 4070>,
				<3983 4029 4039 4036 4030>,
				<3932 3969 3995 3994 3993>,
				<3900 3938 3964 3960 3960>,
				<3878 3899 3935 3931 3930>,
				<3847 3876 3898 3894 3892>,
				<3822 3851 3863 3870 3869>,
				<3814 3838 3845 3843 3842>,
				<3790 3809 3814 3814 3813>,
				<3778 3797 3800 3798 3798>,
				<3767 3789 3788 3785 3786>,
				<3757 3782 3781 3776 3775>,
				<3746 3773 3776 3770 3756>,
				<3735 3759 3766 3757 3739>,
				<3724 3728 3744 3734 3716>,
				<3711 3720 3729 3716 3705>,
				<3699 3715 3712 3705 3696>,
				<3685 3705 3702 3695 3683>,
				<3675 3699 3692 3685 3670>,
				<3659 3690 3686 3675 3651>,
				<3643 3679 3677 3665 3616>,
				<3620 3657 3650 3630 3570>,
				<3580 3607 3596 3572 3501>,
				<3553 3568 3557 3532 3455>,
				<3477 3488 3479 3459 3424>,
				<3448 3448 3450 3427 3412>,
				<3350 3350 3350 3350 3350>;
	};
};
