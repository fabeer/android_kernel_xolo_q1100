/* Copyright (c) 2013, The Linux Foundation. All rights reserved.
 *
 * This program is free software; you can redistribute it and/or modify
 * it under the terms of the GNU General Public License version 2 and
 * only version 2 as published by the Free Software Foundation.
 *
 * This program is distributed in the hope that it will be useful,
 * but WITHOUT ANY WARRANTY; without even the implied warranty of
 * MERCHANTABILITY or FITNESS FOR A PARTICULAR PURPOSE.  See the
 * GNU General Public License for more details.
 */

/*---------------------------------------------------------------------------
 * This file is autogenerated file using gcdb parser. Please do not edit it.
 * Update input XML file to add a new entry or update variable in this file
 * VERSION = "1.0"
 *---------------------------------------------------------------------------*/
&mdss_mdp {
	dsi_nt35521_720_vid: qcom,mdss_dsi_nt35521_720p_video {
		qcom,mdss-dsi-panel-name = "nt35521 720p video mode dsi panel";
		qcom,mdss-dsi-panel-controller = <&mdss_dsi0>;
		qcom,mdss-dsi-panel-type = "dsi_video_mode";
		qcom,mdss-dsi-panel-destination = "display_1";
		qcom,mdss-dsi-panel-framerate = <60>;
		qcom,mdss-dsi-virtual-channel-id = <0>;
		qcom,mdss-dsi-stream = <0>;
		qcom,mdss-dsi-panel-width = <720>;
		qcom,mdss-dsi-panel-height = <1280>;
		qcom,mdss-dsi-h-front-porch = <44>;
		qcom,mdss-dsi-h-back-porch = <55>;
		qcom,mdss-dsi-h-pulse-width = <11>;
		qcom,mdss-dsi-h-sync-skew = <0>;
		qcom,mdss-dsi-v-back-porch = <15>;
		qcom,mdss-dsi-v-front-porch = <14>;
		qcom,mdss-dsi-v-pulse-width = <1>;
		qcom,mdss-dsi-h-left-border = <0>;
		qcom,mdss-dsi-h-right-border = <0>;
		qcom,mdss-dsi-v-top-border = <0>;
		qcom,mdss-dsi-v-bottom-border = <0>;
		qcom,mdss-dsi-bpp = <24>;
		qcom,mdss-dsi-color-order = <0>;
		qcom,mdss-dsi-underflow-color = <0xff>;
		qcom,mdss-dsi-border-color = <0>;
		qcom,mdss-dsi-pixel-packing = <0>;
		qcom,mdss-dsi-on-command = [
                                29 01 00 00 00 00 05 FF AA 55 A5 80
                                29 01 00 00 00 00 03 6F 11 00
                                29 01 00 00 00 00 03 F7 20 00
                                29 01 00 00 00 00 02 6F 06
                                29 01 00 00 00 00 02 F7 A0
                                29 01 00 00 00 00 02 6F 19
                                29 01 00 00 00 00 02 F7 12		
                                29 01 00 00 00 00 06 F0 55 AA 52 08 00
     				29 01 00 00 00 00 02 C8 80
				29 01 00 00 00 00 03 B1 68 21
 				29 01 00 00 00 00 02 B6 08
    				29 01 00 00 00 00 02 6F 02
    				29 01 00 00 00 00 02 B8 08
    				29 01 00 00 00 00 03 BB 74 44
    				29 01 00 00 00 00 03 BC 00 00
    				29 01 00 00 00 00 02 C7 01
    				29 01 00 00 00 00 06 BD 02 B0 10 10 00

    				29 01 00 00 00 00 06 F0 55 AA 52 08 01
    				29 01 00 00 00 00 03 B0 05 05
    				29 01 00 00 00 00 03 B1 05 05
    				29 01 00 00 00 00 03 BC 88 00
    				29 01 00 00 00 00 03 BD 88 00
    				29 01 00 00 00 00 02 CA 87
    				29 01 00 00 00 00 02 C0 04
    				29 01 00 00 00 00 02 BE 40
    				29 01 00 00 00 00 03 B3 47 47
    				29 01 00 00 00 00 03 B4 0F 0F
    				29 01 00 00 00 00 03 B9 36 36
    				29 01 00 00 00 00 03 BA 24 24
    				29 01 00 00 00 00 11 B0 00 00 00 26 00 4E 00 6A 00 80 00 A4 00 BF 00 EA
    				29 01 00 00 00 00 11 B1 01 14 01 55 01 85 01 D5 02 15 02 17 02 57 02 97
    				29 01 00 00 00 00 11 B2 02 C6 03 01 03 27 03 56 03 76 03 9F 03 B8 03 D5
    				29 01 00 00 00 00 05 B3 03 F9 03 FF
    
				29 01 00 00 00 00 06 F0 55 AA 52 08 02
				29 01 00 00 00 00 11 B0 00 AC 00 BA 00 D9 00 ED 01 01 01 1E 01 3A 01 62
				29 01 00 00 00 00 11 B1 01 85 01 B8 01 E4 02 27 02 5B 02 5D 02 8C 02 BE
				29 01 00 00 00 00 11 B2 02 DF 03 0C 03 2A 03 51 03 6D 03 8D 03 A4 03 BE
				29 01 00 00 00 00 05 B3 03 CC 03 CC
				29 01 00 00 00 00 11 B4 00 AC 00 BA 00 D9 00 ED 01 01 01 1E 01 3A 01 62
				29 01 00 00 00 00 11 B5 01 85 01 B8 01 E4 02 27 02 5B 02 5D 02 8C 02 BE
				29 01 00 00 00 00 11 B6 02 DF 03 0C 03 2A 03 51 03 6D 03 8D 03 A4 03 BE
				29 01 00 00 00 00 05 B7 03 CC 03 CC
				29 01 00 00 00 00 11 B8 00 AC 00 BA 00 D9 00 ED 01 01 01 1E 01 3A 01 62
				29 01 00 00 00 00 11 B9 01 85 01 B8 01 E4 02 27 02 5B 02 5D 02 8C 02 BE
				29 01 00 00 00 00 11 BA 02 DF 03 0C 03 2A 03 51 03 6D 03 8D 03 A4 03 BE
				29 01 00 00 00 00 05 BB 03 CC 03 CC
				29 01 00 00 00 00 11 BC 00 AC 00 BA 00 D9 00 ED 01 01 01 1E 01 3A 01 62
				29 01 00 00 00 00 11 BD 01 85 01 B8 01 E4 02 27 02 5B 02 5D 02 8C 02 BE
				29 01 00 00 00 00 11 BE 02 DF 03 0C 03 2A 03 51 03 6D 03 8D 03 A4 03 BE
				29 01 00 00 00 00 05 BF 03 CC 03 CC
				29 01 00 00 00 00 11 C0 00 AC 00 BA 00 D9 00 ED 01 01 01 1E 01 3A 01 62
				29 01 00 00 00 00 11 C1 01 85 01 B8 01 E4 02 27 02 5B 02 5D 02 8C 02 BE
				29 01 00 00 00 00 11 C2 02 DF 03 0C 03 2A 03 51 03 6D 03 8D 03 A4 03 BE
				29 01 00 00 00 00 05 C3 03 CC 03 CC
				29 01 00 00 00 00 11 C4 00 AC 00 BA 00 D9 00 ED 01 01 01 1E 01 3A 01 62
				29 01 00 00 00 00 11 C5 01 85 01 B8 01 E4 02 27 02 5B 02 5D 02 8C 02 BE
				29 01 00 00 00 00 11 C6 02 DF 03 0C 03 2A 03 51 03 6D 03 8D 03 A4 03 BE
				29 01 00 00 00 00 05 C7 03 CC 03 CC
				23 01 00 00 00 00 02 EE 00
    				29 01 00 00 00 00 06 F0 55 AA 52 08 03
    				29 01 00 00 00 00 03 B0 20 00
    				29 01 00 00 00 00 03 B1 20 00
    				29 01 00 00 00 00 06 B2 05 00 00 00 00
    				29 01 00 00 00 00 06 B6 05 00 00 00 00
    				29 01 00 00 00 00 06 B7 05 00 00 00 00
    				29 01 00 00 00 00 06 BA 57 00 00 00 00
    				29 01 00 00 00 00 06 BB 57 00 00 00 00
    				29 01 00 00 00 00 05 C0 00 00 00 00
    				29 01 00 00 00 00 05 C1 00 00 00 00
    				29 01 00 00 00 00 02 C4 60
    				29 01 00 00 00 00 02 C5 40
				
    				29 01 00 00 00 00 06 F0 55 AA 52 08 05
    				29 01 00 00 00 00 06 BD 03 01 03 03 03
    				29 01 00 00 00 00 03 B0 17 06
    				29 01 00 00 00 00 03 B1 17 06
    				29 01 00 00 00 00 03 B2 17 06
    				29 01 00 00 00 00 03 B3 17 06
    				29 01 00 00 00 00 03 B4 17 06
    				29 01 00 00 00 00 03 B5 17 06
    				29 01 00 00 00 00 02 B8 00
    				29 01 00 00 00 00 02 B9 00
    				29 01 00 00 00 00 02 BA 00
    				29 01 00 00 00 00 02 BB 02
    				29 01 00 00 00 00 02 BC 00
    				29 01 00 00 00 00 02 C0 07
    				29 01 00 00 00 00 02 C4 81
    				29 01 00 00 00 00 02 C5 A3
    				29 01 00 00 00 00 03 C8 05 30
    				29 01 00 00 00 00 03 C9 01 31
    				29 01 00 00 00 00 04 CC 00 00 3C
    				29 01 00 00 00 00 04 CD 00 00 3C
    				29 01 00 00 00 00 06 D1 00 04 FD 07 10
    				29 01 00 00 00 00 06 D2 00 05 02 07 10
    				29 01 00 00 00 00 02 E5 06
    				29 01 00 00 00 00 02 E6 06
    				29 01 00 00 00 00 02 E7 06
    				29 01 00 00 00 00 02 E8 06
    				29 01 00 00 00 00 02 E9 06
    				29 01 00 00 00 00 02 EA 06
    				29 01 00 00 00 00 02 ED 30
    				29 01 00 00 00 00 02 6F 11
    				29 01 00 00 00 00 02 F3 01
				29 01 00 00 00 00 06 F0 55 AA 52 08 06
    				29 01 00 00 00 00 03 B0 00 10
    				29 01 00 00 00 00 03 B1 12 14
   				29 01 00 00 00 00 03 B2 16 18
    				29 01 00 00 00 00 03 B3 1A 29
    				29 01 00 00 00 00 03 B4 2A 08
    				29 01 00 00 00 00 03 B5 31 31
    				29 01 00 00 00 00 03 B6 31 31
    				29 01 00 00 00 00 03 B7 31 31
    				29 01 00 00 00 00 03 B8 31 0A
    				29 01 00 00 00 00 03 B9 31 31
    				29 01 00 00 00 00 03 BA 31 31
    				29 01 00 00 00 00 03 BB 0B 31
    				29 01 00 00 00 00 03 BC 31 31
    				29 01 00 00 00 00 03 BD 31 31
    				29 01 00 00 00 00 03 BE 31 31
    				29 01 00 00 00 00 03 BF 09 2A
    				29 01 00 00 00 00 03 C0 29 1B
    				29 01 00 00 00 00 03 C1 19 17
    				29 01 00 00 00 00 03 C2 15 13
    				29 01 00 00 00 00 03 C3 11 01
    				29 01 00 00 00 00 03 E5 31 31
    				29 01 00 00 00 00 03 C4 09 1B
    				29 01 00 00 00 00 03 C5 19 17
    				29 01 00 00 00 00 03 C6 15 13
    				29 01 00 00 00 00 03 C7 11 29
    				29 01 00 00 00 00 03 C8 2A 01
    				29 01 00 00 00 00 03 C9 31 31
    				29 01 00 00 00 00 03 CA 31 31
    				29 01 00 00 00 00 03 CB 31 31
    				29 01 00 00 00 00 03 CC 31 0B
    				29 01 00 00 00 00 03 CD 31 31
    				29 01 00 00 00 00 03 CE 31 31
    				29 01 00 00 00 00 03 CF 0A 31
    				29 01 00 00 00 00 03 D0 31 31
    				29 01 00 00 00 00 03 D1 31 31
    				29 01 00 00 00 00 03 D2 31 31
    				29 01 00 00 00 00 03 D3 00 2A
    				29 01 00 00 00 00 03 D4 29 10
    				29 01 00 00 00 00 03 D5 12 14
    				29 01 00 00 00 00 03 D6 16 18
    				29 01 00 00 00 00 03 D7 1A 08
    				29 01 00 00 00 00 03 E6 31 31
    				29 01 00 00 00 00 06 D8 00 00 00 54 00
    				29 01 00 00 00 00 06 D9 00 15 00 00 00
    				29 01 00 00 00 00 02 E7 00
				29 01 00 00 00 00 06 F0 55 AA 52 00 00
				05 01 00 00 32 00 02 11 00
				05 01 00 00 96 00 02 29 00
				29 01 00 00 00 00 06 F0 55 AA 52 08 01
				29 01 00 00 00 00 06 F0 55 AA 52 00 00
				29 01 00 00 00 00 02 53 2C];
		qcom,mdss-dsi-off-command = [05 01 00 00 32 00 02 28 00
					05 01 00 00 78 00 02 10 00];
		qcom,mdss-dsi-on-command-state = "dsi_lp_mode";
		qcom,mdss-dsi-off-command-state = "dsi_hs_mode";
		qcom,mdss-dsi-h-sync-pulse = <1>;
		qcom,mdss-dsi-traffic-mode = <2>;
		qcom,mdss-dsi-lane-map = <0>;
		qcom,mdss-dsi-bllp-eof-power-mode;
		qcom,mdss-dsi-bllp-power-mode;
		qcom,mdss-dsi-lane-0-state;
		qcom,mdss-dsi-lane-1-state;
		qcom,mdss-dsi-lane-2-state;
		qcom,mdss-dsi-lane-3-state;
		qcom,mdss-dsi-panel-timings = [93 1F 17 00 2F 2E 1C 21 26 03 04 00];
		qcom,mdss-dsi-t-clk-post = <0x20>;
		qcom,mdss-dsi-t-clk-pre = <0x2D>;
		qcom,mdss-dsi-bl-min-level = <0>;
		qcom,mdss-dsi-bl-max-level = <255>;
		qcom,mdss-dsi-dma-trigger = <4>;
		qcom,mdss-dsi-mdp-trigger = <0>;
		qcom,mdss-pan-bl-levels = <1 255>;
		qcom,mdss-dsi-bl-pmic-control-type = "bl_ctrl_wled";
		qcom,mdss-dsi-reset-sequence = <1 20>, <0 20>, <1 20>;
	};
};
