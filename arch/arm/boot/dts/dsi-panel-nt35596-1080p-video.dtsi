/* Copyright (c) 2013, The Linux Foundation. All rights reserved.
 *
 * This program is free software; you can redistribute it and/or modify
 * it under the terms of the GNU General Public License version 2 and
 * only version 2 as published by the Free Software Foundation.
 *
 * This program is distributed in the hope that it will be useful,
 * but WITHOUT ANY WARRANTY; without even the implied warranty of
 * MERCHANTABILITY or FITNESS FOR A PARTICULAR PURPOSE.  See the
 * GNU General Public License for more details.
 */

/*---------------------------------------------------------------------------
 * This file is autogenerated file using gcdb parser. Please do not edit it.
 * Update input XML file to add a new entry or update variable in this file
 * VERSION = "1.0"
 *---------------------------------------------------------------------------*/
&mdss_mdp {
	dsi_nt35596_1080_vid: qcom,mdss_dsi_nt35596_1080p_video {
		qcom,mdss-dsi-panel-name = "nt35596 1080p video mode dsi panel";
		qcom,mdss-dsi-panel-controller = <&mdss_dsi0>;
		qcom,mdss-dsi-panel-type = "dsi_video_mode";
		qcom,mdss-dsi-panel-destination = "display_1";
		qcom,mdss-dsi-panel-framerate = <60>;
		qcom,mdss-dsi-virtual-channel-id = <0>;
		qcom,mdss-dsi-stream = <0>;
		qcom,mdss-dsi-panel-width = <1080>;
		qcom,mdss-dsi-panel-height = <1920>;
		qcom,mdss-dsi-h-front-porch = <70>;
		qcom,mdss-dsi-h-back-porch = <37>;
		qcom,mdss-dsi-h-pulse-width = <8>;
		qcom,mdss-dsi-h-sync-skew = <0>;
		qcom,mdss-dsi-v-back-porch = <2>;
		qcom,mdss-dsi-v-front-porch = <2>;
		qcom,mdss-dsi-v-pulse-width = <4>;
		qcom,mdss-dsi-h-left-border = <0>;
		qcom,mdss-dsi-h-right-border = <0>;
		qcom,mdss-dsi-v-top-border = <0>;
		qcom,mdss-dsi-v-bottom-border = <0>;
		qcom,mdss-dsi-bpp = <24>;
		qcom,mdss-dsi-color-order = <0>;
		qcom,mdss-dsi-underflow-color = <0xff>;
		qcom,mdss-dsi-border-color = <0>;
		qcom,mdss-dsi-on-command = [		
		29 01 00 00 00 00 02 FF 05 
		29 01 00 00 00 00 02 FB 01
		29 01 00 00 00 00 02 C5 01          
		29 01 00 00 00 00 02 90 00          
		29 01 00 00 00 00 02 93 04
		29 01 00 00 00 00 02 94 04                    
		29 01 00 00 00 00 02 9B 0F
		29 01 00 00 00 00 02 A4 0F                    
		29 01 00 00 00 00 02 91 44
		29 01 00 00 00 00 02 92 79
		29 01 00 00 00 00 02 00 0F
		29 01 00 00 00 00 02 01 00
		29 01 00 00 00 00 02 02 00
		29 01 00 00 00 00 02 03 00
		29 01 00 00 00 00 02 04 0B
		29 01 00 00 00 00 02 05 0C
		29 01 00 00 00 00 02 06 00
		29 01 00 00 00 00 02 07 00
		29 01 00 00 00 00 02 08 00
		29 01 00 00 00 00 02 09 00
		29 01 00 00 00 00 02 0A 04
		29 01 00 00 00 00 02 0B 03
		29 01 00 00 00 00 02 0C 01
		29 01 00 00 00 00 02 0D 13
		29 01 00 00 00 00 02 0E 15
		29 01 00 00 00 00 02 0F 17
		29 01 00 00 00 00 02 10 0F
		29 01 00 00 00 00 02 11 00
		29 01 00 00 00 00 02 12 00
		29 01 00 00 00 00 02 13 00
		29 01 00 00 00 00 02 14 0B
		29 01 00 00 00 00 02 15 0C
		29 01 00 00 00 00 02 16 00
		29 01 00 00 00 00 02 17 00
		29 01 00 00 00 00 02 18 00
		29 01 00 00 00 00 02 19 00
		29 01 00 00 00 00 02 1A 04
		29 01 00 00 00 00 02 1B 03
		29 01 00 00 00 00 02 1C 01
		29 01 00 00 00 00 02 1D 13
		29 01 00 00 00 00 02 1E 15
		29 01 00 00 00 00 02 1F 17       
		29 01 00 00 00 00 02 20 00
		29 01 00 00 00 00 02 21 00
		29 01 00 00 00 00 02 22 09
		29 01 00 00 00 00 02 23 05
		29 01 00 00 00 00 02 24 05
		29 01 00 00 00 00 02 25 6D       
		29 01 00 00 00 00 02 2F 01
		29 01 00 00 00 00 02 30 01
		29 01 00 00 00 00 02 31 00
		29 01 00 00 00 00 02 32 32
		29 01 00 00 00 00 02 33 01
		29 01 00 00 00 00 02 34 03
		29 01 00 00 00 00 02 35 68
		29 01 00 00 00 00 02 36 00
		29 01 00 00 00 00 02 37 2D
		29 01 00 00 00 00 02 38 08	       
		29 01 00 00 00 00 02 29 58
		29 01 00 00 00 00 02 2A 16
		29 01 00 00 00 00 02 2B 0A       
		29 01 00 00 00 00 02 5B 00
		29 01 00 00 00 00 02 5F 75
		29 01 00 00 00 00 02 63 00
		29 01 00 00 00 00 02 67 04
		29 01 00 00 00 00 02 6C 00       
		29 01 00 00 00 00 02 5C 2C
		29 01 00 00 00 00 02 60 75
		29 01 00 00 00 00 02 64 00
		29 01 00 00 00 00 02 68 04
		29 01 00 00 00 00 02 6C 10		       
		29 01 00 00 00 00 02 5D 00
		29 01 00 00 00 00 02 61 75
		29 01 00 00 00 00 02 65 00
		29 01 00 00 00 00 02 69 04
		29 01 00 00 00 00 02 6C 00	       
		29 01 00 00 00 00 02 6C 10	       
		29 01 00 00 00 00 02 7A 01
		29 01 00 00 00 00 02 7B 80
		29 01 00 00 00 00 02 7C D8
		29 01 00 00 00 00 02 7D 60
		29 01 00 00 00 00 02 7E 07
		29 01 00 00 00 00 02 7F 17
		29 01 00 00 00 00 02 80 00
		29 01 00 00 00 00 02 81 05
		29 01 00 00 00 00 02 82 02
		29 01 00 00 00 00 02 83 00
		29 01 00 00 00 00 02 84 05
		29 01 00 00 00 00 02 85 05
		29 01 00 00 00 00 02 86 1B
		29 01 00 00 00 00 02 87 1B
		29 01 00 00 00 00 02 88 1B
		29 01 00 00 00 00 02 89 1B
		29 01 00 00 00 00 02 8A 33
		29 01 00 00 00 00 02 8B 00
		29 01 00 00 00 00 02 8C 00     
		29 01 00 00 00 00 02 73 D0
		29 01 00 00 00 00 02 74 0D
		29 01 00 00 00 00 02 75 03
		29 01 00 00 00 00 02 76 16           
		29 01 00 00 00 00 02 99 33
		29 01 00 00 00 00 02 98 00
		29 01 00 00 00 00 02 FF 01
		29 01 00 00 00 00 02 75 00
		29 01 00 00 00 00 02 76 02
		29 01 00 00 00 00 02 77 00
		29 01 00 00 00 00 02 78 29
		29 01 00 00 00 00 02 79 00
		29 01 00 00 00 00 02 7A 53
		29 01 00 00 00 00 02 7B 00
		29 01 00 00 00 00 02 7C 6F
		29 01 00 00 00 00 02 7D 00
		29 01 00 00 00 00 02 7E 85
		29 01 00 00 00 00 02 7F 00
		29 01 00 00 00 00 02 80 98
		29 01 00 00 00 00 02 81 00
		29 01 00 00 00 00 02 82 A8
		29 01 00 00 00 00 02 83 00
		29 01 00 00 00 00 02 84 B7
		29 01 00 00 00 00 02 85 00
		29 01 00 00 00 00 02 86 C5
		29 01 00 00 00 00 02 87 00
		29 01 00 00 00 00 02 88 F2
		29 01 00 00 00 00 02 89 01
		29 01 00 00 00 00 02 8A 17
		29 01 00 00 00 00 02 8B 01
		29 01 00 00 00 00 02 8C 51
		29 01 00 00 00 00 02 8D 01
		29 01 00 00 00 00 02 8E 80
		29 01 00 00 00 00 02 8F 01
		29 01 00 00 00 00 02 90 CA
		29 01 00 00 00 00 02 91 02
		29 01 00 00 00 00 02 92 06
		29 01 00 00 00 00 02 93 02
		29 01 00 00 00 00 02 94 08
		29 01 00 00 00 00 02 95 02
		29 01 00 00 00 00 02 96 40
		29 01 00 00 00 00 02 97 02
		29 01 00 00 00 00 02 98 7E
		29 01 00 00 00 00 02 99 02
		29 01 00 00 00 00 02 9A A4
		29 01 00 00 00 00 02 9B 02
		29 01 00 00 00 00 02 9C D7
		29 01 00 00 00 00 02 9D 02
		29 01 00 00 00 00 02 9E F9
		29 01 00 00 00 00 02 9F 03
		29 01 00 00 00 00 02 A0 25
		29 01 00 00 00 00 02 A2 03
		29 01 00 00 00 00 02 A3 32
		29 01 00 00 00 00 02 A4 03
		29 01 00 00 00 00 02 A5 41
		29 01 00 00 00 00 02 A6 03
		29 01 00 00 00 00 02 A7 51
		29 01 00 00 00 00 02 A9 03
		29 01 00 00 00 00 02 AA 64
		29 01 00 00 00 00 02 AB 03
		29 01 00 00 00 00 02 AC 7B
		29 01 00 00 00 00 02 AD 03
		29 01 00 00 00 00 02 AE 96
		29 01 00 00 00 00 02 AF 03
		29 01 00 00 00 00 02 B0 BF
		29 01 00 00 00 00 02 B1 03
		29 01 00 00 00 00 02 B2 CF
		29 01 00 00 00 00 02 B3 00
		29 01 00 00 00 00 02 B4 02
		29 01 00 00 00 00 02 B5 00
		29 01 00 00 00 00 02 B6 29
		29 01 00 00 00 00 02 B7 00
		29 01 00 00 00 00 02 B8 53
		29 01 00 00 00 00 02 B9 00
		29 01 00 00 00 00 02 BA 6F
		29 01 00 00 00 00 02 BB 00
		29 01 00 00 00 00 02 BC 85
		29 01 00 00 00 00 02 BD 00
		29 01 00 00 00 00 02 BE 98
		29 01 00 00 00 00 02 BF 00
		29 01 00 00 00 00 02 C0 A8
		29 01 00 00 00 00 02 C1 00
		29 01 00 00 00 00 02 C2 B7
		29 01 00 00 00 00 02 C3 00
		29 01 00 00 00 00 02 C4 C5
		29 01 00 00 00 00 02 C5 00
		29 01 00 00 00 00 02 C6 F2
		29 01 00 00 00 00 02 C7 01
		29 01 00 00 00 00 02 C8 17
		29 01 00 00 00 00 02 C9 01
		29 01 00 00 00 00 02 CA 51
		29 01 00 00 00 00 02 CB 01
		29 01 00 00 00 00 02 CC 80
		29 01 00 00 00 00 02 CD 01
		29 01 00 00 00 00 02 CE CA
		29 01 00 00 00 00 02 CF 02
		29 01 00 00 00 00 02 D0 06
		29 01 00 00 00 00 02 D1 02
		29 01 00 00 00 00 02 D2 08
		29 01 00 00 00 00 02 D3 02
		29 01 00 00 00 00 02 D4 40
		29 01 00 00 00 00 02 D5 02
		29 01 00 00 00 00 02 D6 7E
		29 01 00 00 00 00 02 D7 02
		29 01 00 00 00 00 02 D8 A4
		29 01 00 00 00 00 02 D9 02
		29 01 00 00 00 00 02 DA D7
		29 01 00 00 00 00 02 DB 02
		29 01 00 00 00 00 02 DC F9
		29 01 00 00 00 00 02 DD 03
		29 01 00 00 00 00 02 DE 25
		29 01 00 00 00 00 02 DF 03
		29 01 00 00 00 00 02 E0 32
		29 01 00 00 00 00 02 E1 03
		29 01 00 00 00 00 02 E2 41
		29 01 00 00 00 00 02 E3 03
		29 01 00 00 00 00 02 E4 51
		29 01 00 00 00 00 02 E5 03
		29 01 00 00 00 00 02 E6 64
		29 01 00 00 00 00 02 E7 03
		29 01 00 00 00 00 02 E8 7B
		29 01 00 00 00 00 02 E9 03
		29 01 00 00 00 00 02 EA 96
		29 01 00 00 00 00 02 EB 03
		29 01 00 00 00 00 02 EC BF
		29 01 00 00 00 00 02 ED 03
		29 01 00 00 00 00 02 EE CF
		29 01 00 00 00 00 02 EF 00
		29 01 00 00 00 00 02 F0 02
		29 01 00 00 00 00 02 F1 00
		29 01 00 00 00 00 02 F2 29
		29 01 00 00 00 00 02 F3 00
		29 01 00 00 00 00 02 F4 53
		29 01 00 00 00 00 02 F5 00
		29 01 00 00 00 00 02 F6 6F
		29 01 00 00 00 00 02 F7 00
		29 01 00 00 00 00 02 F8 85
		29 01 00 00 00 00 02 F9 00
		29 01 00 00 00 00 02 FA 98
		29 01 00 00 00 00 02 FF 02
		29 01 00 00 00 00 02 00 00
		29 01 00 00 00 00 02 01 A8
		29 01 00 00 00 00 02 02 00
		29 01 00 00 00 00 02 03 B7
		29 01 00 00 00 00 02 04 00
		29 01 00 00 00 00 02 05 C5
		29 01 00 00 00 00 02 06 00
		29 01 00 00 00 00 02 07 F2
		29 01 00 00 00 00 02 08 01
		29 01 00 00 00 00 02 09 17
		29 01 00 00 00 00 02 0A 01
		29 01 00 00 00 00 02 0B 51
		29 01 00 00 00 00 02 0C 01
		29 01 00 00 00 00 02 0D 80
		29 01 00 00 00 00 02 0E 01
		29 01 00 00 00 00 02 0F CA
		29 01 00 00 00 00 02 10 02
		29 01 00 00 00 00 02 11 06
		29 01 00 00 00 00 02 12 02
		29 01 00 00 00 00 02 13 08
		29 01 00 00 00 00 02 14 02
		29 01 00 00 00 00 02 15 40
		29 01 00 00 00 00 02 16 02
		29 01 00 00 00 00 02 17 7E
		29 01 00 00 00 00 02 18 02
		29 01 00 00 00 00 02 19 A4
		29 01 00 00 00 00 02 1A 02
		29 01 00 00 00 00 02 1B D7
		29 01 00 00 00 00 02 1C 02
		29 01 00 00 00 00 02 1D F9
		29 01 00 00 00 00 02 1E 03
		29 01 00 00 00 00 02 1F 25
		29 01 00 00 00 00 02 20 03
		29 01 00 00 00 00 02 21 32
		29 01 00 00 00 00 02 22 03
		29 01 00 00 00 00 02 23 41
		29 01 00 00 00 00 02 24 03
		29 01 00 00 00 00 02 25 51
		29 01 00 00 00 00 02 26 03
		29 01 00 00 00 00 02 27 64
		29 01 00 00 00 00 02 28 03
		29 01 00 00 00 00 02 29 7B
		29 01 00 00 00 00 02 2A 03
		29 01 00 00 00 00 02 2B 96
		29 01 00 00 00 00 02 2D 03
		29 01 00 00 00 00 02 2F BF
		29 01 00 00 00 00 02 30 03
		29 01 00 00 00 00 02 31 CF
		29 01 00 00 00 00 02 32 00
		29 01 00 00 00 00 02 33 02
		29 01 00 00 00 00 02 34 00
		29 01 00 00 00 00 02 35 29
		29 01 00 00 00 00 02 36 00
		29 01 00 00 00 00 02 37 53
		29 01 00 00 00 00 02 38 00
		29 01 00 00 00 00 02 39 6F
		29 01 00 00 00 00 02 3A 00
		29 01 00 00 00 00 02 3B 85
		29 01 00 00 00 00 02 3D 00
		29 01 00 00 00 00 02 3F 98
		29 01 00 00 00 00 02 40 00
		29 01 00 00 00 00 02 41 A8
		29 01 00 00 00 00 02 42 00
		29 01 00 00 00 00 02 43 B7
		29 01 00 00 00 00 02 44 00
		29 01 00 00 00 00 02 45 C5
		29 01 00 00 00 00 02 46 00
		29 01 00 00 00 00 02 47 F2
		29 01 00 00 00 00 02 48 01
		29 01 00 00 00 00 02 49 17
		29 01 00 00 00 00 02 4A 01
		29 01 00 00 00 00 02 4B 51
		29 01 00 00 00 00 02 4C 01
		29 01 00 00 00 00 02 4D 80
		29 01 00 00 00 00 02 4E 01
		29 01 00 00 00 00 02 4F CA
		29 01 00 00 00 00 02 50 02
		29 01 00 00 00 00 02 51 06
		29 01 00 00 00 00 02 52 02
		29 01 00 00 00 00 02 53 08
		29 01 00 00 00 00 02 54 02
		29 01 00 00 00 00 02 55 40
		29 01 00 00 00 00 02 56 02
		29 01 00 00 00 00 02 58 7E
		29 01 00 00 00 00 02 59 02
		29 01 00 00 00 00 02 5A A4
		29 01 00 00 00 00 02 5B 02
		29 01 00 00 00 00 02 5C D7
		29 01 00 00 00 00 02 5D 02
		29 01 00 00 00 00 02 5E F9
		29 01 00 00 00 00 02 5F 03
		29 01 00 00 00 00 02 60 25
		29 01 00 00 00 00 02 61 03
		29 01 00 00 00 00 02 62 32
		29 01 00 00 00 00 02 63 03
		29 01 00 00 00 00 02 64 41
		29 01 00 00 00 00 02 65 03
		29 01 00 00 00 00 02 66 51
		29 01 00 00 00 00 02 67 03
		29 01 00 00 00 00 02 68 64
		29 01 00 00 00 00 02 69 03
		29 01 00 00 00 00 02 6A 7B
		29 01 00 00 00 00 02 6B 03
		29 01 00 00 00 00 02 6C 96
		29 01 00 00 00 00 02 6D 03
		29 01 00 00 00 00 02 6E BF
		29 01 00 00 00 00 02 6F 03
		29 01 00 00 00 00 02 70 CF
		29 01 00 00 00 00 02 71 00
		29 01 00 00 00 00 02 72 02
		29 01 00 00 00 00 02 73 00
		29 01 00 00 00 00 02 74 29
		29 01 00 00 00 00 02 75 00
		29 01 00 00 00 00 02 76 53
		29 01 00 00 00 00 02 77 00
		29 01 00 00 00 00 02 78 6F
		29 01 00 00 00 00 02 79 00
		29 01 00 00 00 00 02 7A 85
		29 01 00 00 00 00 02 7B 00
		29 01 00 00 00 00 02 7C 98
		29 01 00 00 00 00 02 7D 00
		29 01 00 00 00 00 02 7E A8
		29 01 00 00 00 00 02 7F 00
		29 01 00 00 00 00 02 80 B7
		29 01 00 00 00 00 02 81 00
		29 01 00 00 00 00 02 82 C5
		29 01 00 00 00 00 02 83 00
		29 01 00 00 00 00 02 84 F2
		29 01 00 00 00 00 02 85 01
		29 01 00 00 00 00 02 86 17
		29 01 00 00 00 00 02 87 01
		29 01 00 00 00 00 02 88 51
		29 01 00 00 00 00 02 89 01
		29 01 00 00 00 00 02 8A 80
		29 01 00 00 00 00 02 8B 01
		29 01 00 00 00 00 02 8C CA
		29 01 00 00 00 00 02 8D 02
		29 01 00 00 00 00 02 8E 06
		29 01 00 00 00 00 02 8F 02
		29 01 00 00 00 00 02 90 08
		29 01 00 00 00 00 02 91 02
		29 01 00 00 00 00 02 92 40
		29 01 00 00 00 00 02 93 02
		29 01 00 00 00 00 02 94 7E
		29 01 00 00 00 00 02 95 02
		29 01 00 00 00 00 02 96 A4
		29 01 00 00 00 00 02 97 02
		29 01 00 00 00 00 02 98 D7
		29 01 00 00 00 00 02 99 02
		29 01 00 00 00 00 02 9A F9
		29 01 00 00 00 00 02 9B 03
		29 01 00 00 00 00 02 9C 25
		29 01 00 00 00 00 02 9D 03
		29 01 00 00 00 00 02 9E 32
		29 01 00 00 00 00 02 9F 03
		29 01 00 00 00 00 02 A0 41
		29 01 00 00 00 00 02 A2 03
		29 01 00 00 00 00 02 A3 51
		29 01 00 00 00 00 02 A4 03
		29 01 00 00 00 00 02 A5 64
		29 01 00 00 00 00 02 A6 03
		29 01 00 00 00 00 02 A7 7B
		29 01 00 00 00 00 02 A9 03
		29 01 00 00 00 00 02 AA 96
		29 01 00 00 00 00 02 AB 03
		29 01 00 00 00 00 02 AC BF
		29 01 00 00 00 00 02 AD 03
		29 01 00 00 00 00 02 AE CF
		29 01 00 00 00 00 02 AF 00
		29 01 00 00 00 00 02 B0 02
		29 01 00 00 00 00 02 B1 00
		29 01 00 00 00 00 02 B2 29
		29 01 00 00 00 00 02 B3 00
		29 01 00 00 00 00 02 B4 53
		29 01 00 00 00 00 02 B5 00
		29 01 00 00 00 00 02 B6 6F
		29 01 00 00 00 00 02 B7 00
		29 01 00 00 00 00 02 B8 85
		29 01 00 00 00 00 02 B9 00
		29 01 00 00 00 00 02 BA 98
		29 01 00 00 00 00 02 BB 00
		29 01 00 00 00 00 02 BC A8
		29 01 00 00 00 00 02 BD 00
		29 01 00 00 00 00 02 BE B7
		29 01 00 00 00 00 02 BF 00
		29 01 00 00 00 00 02 C0 C5
		29 01 00 00 00 00 02 C1 00
		29 01 00 00 00 00 02 C2 F2
		29 01 00 00 00 00 02 C3 01
		29 01 00 00 00 00 02 C4 17
		29 01 00 00 00 00 02 C5 01
		29 01 00 00 00 00 02 C6 51
		29 01 00 00 00 00 02 C7 01
		29 01 00 00 00 00 02 C8 80
		29 01 00 00 00 00 02 C9 01
		29 01 00 00 00 00 02 CA CA
		29 01 00 00 00 00 02 CB 02
		29 01 00 00 00 00 02 CC 06
		29 01 00 00 00 00 02 CD 02
		29 01 00 00 00 00 02 CE 08
		29 01 00 00 00 00 02 CF 02
		29 01 00 00 00 00 02 D0 40
		29 01 00 00 00 00 02 D1 02
		29 01 00 00 00 00 02 D2 7E
		29 01 00 00 00 00 02 D3 02
		29 01 00 00 00 00 02 D4 A4
		29 01 00 00 00 00 02 D5 02
		29 01 00 00 00 00 02 D6 D7
		29 01 00 00 00 00 02 D7 02
		29 01 00 00 00 00 02 D8 F9
		29 01 00 00 00 00 02 D9 03
		29 01 00 00 00 00 02 DA 25
		29 01 00 00 00 00 02 DB 03
		29 01 00 00 00 00 02 DC 32
		29 01 00 00 00 00 02 DD 03
		29 01 00 00 00 00 02 DE 41
		29 01 00 00 00 00 02 DF 03
		29 01 00 00 00 00 02 E0 51
		29 01 00 00 00 00 02 E1 03
		29 01 00 00 00 00 02 E2 64
		29 01 00 00 00 00 02 E3 03
		29 01 00 00 00 00 02 E4 7B
		29 01 00 00 00 00 02 E5 03
		29 01 00 00 00 00 02 E6 96
		29 01 00 00 00 00 02 E7 03
		29 01 00 00 00 00 02 E8 BF
		29 01 00 00 00 00 02 E9 03
		29 01 00 00 00 00 02 EA CF
		29 01 00 00 00 00 02 FF 01
		29 01 00 00 00 00 02 00 01
		29 01 00 00 00 00 02 05 50 
		29 01 00 00 00 00 02 06 4A
		29 01 00 00 00 00 02 14 A8
		29 01 00 00 00 00 02 07 B2
		29 01 00 00 00 00 02 0E B5
		29 01 00 00 00 00 02 0F B8
		29 01 00 00 00 00 02 0B 69
		29 01 00 00 00 00 02 0C 69
		29 01 00 00 00 00 02 11 13
		29 01 00 00 00 00 02 12 13
		29 01 00 00 00 00 02 08 0C
		29 01 00 00 00 00 02 15 13
		29 01 00 00 00 00 02 16 13
		29 01 00 00 00 00 02 FF E0
		29 01 00 00 00 00 02 46 63
		29 01 00 00 00 00 02 FB 01
		29 01 00 00 00 00 02 FF 00
		29 01 00 00 00 00 02 D3 08
		29 01 00 00 00 00 02 D4 08
		29 01 00 00 96 00 02 11 00
		29 01 00 00 00 00 02 29 00];
		qcom,mdss-dsi-off-command = [05 01 00 00 32 00 02 28 00
					05 01 00 00 78 00 02 10 00];
		qcom,mdss-dsi-on-command-state = "dsi_lp_mode";
		qcom,mdss-dsi-off-command-state = "dsi_hs_mode";
		qcom,mdss-dsi-h-sync-pulse = <1>;
		qcom,mdss-dsi-traffic-mode = <2>;
		qcom,mdss-dsi-lane-map = <0>;
		qcom,mdss-dsi-bllp-eof-power-mode;
		qcom,mdss-dsi-bllp-power-mode;
		qcom,mdss-dsi-lane-0-state;
		qcom,mdss-dsi-lane-1-state;
		qcom,mdss-dsi-lane-2-state;
		qcom,mdss-dsi-lane-3-state;
		qcom,mdss-dsi-panel-timings = [f9 3d 34 00 58 4d 36 3f 53 03 04 00];
		qcom,mdss-dsi-t-clk-post = <0x1e>;
		qcom,mdss-dsi-t-clk-pre = <0x38>;
		qcom,mdss-dsi-bl-min-level = <1>;
		qcom,mdss-dsi-bl-max-level = <255>;
		qcom,mdss-dsi-dma-trigger = <4>;
		qcom,mdss-dsi-mdp-trigger = <0>;
		qcom,mdss-pan-bl-levels = <1 255>;
		qcom,mdss-dsi-bl-pmic-control-type = "bl_ctrl_wled";
		qcom,mdss-dsi-reset-sequence = <1 20>, <0 1>, <1 20>;

	};
};
