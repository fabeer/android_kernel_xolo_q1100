## drivers/input/touchscreen/gt968/Kconfig
```kconfig
#
# Goodix GT968 Touchscreen driver
#

config GT968_TOUCHPANEL_DRIVER
	tristate "Goodix GT968 touchpanel driver"
	depends on TOUCHSCREEN_GT968
	default n
	help
	  This is the main file for touchpanel driver for Goodix GT968
	  touchscreens.

	  Say Y here if you have a Goodix GT968 touchscreen connected
	  to your system.

	  If unsure, say N.

	  To compile this driver as a module, choose M here: the
	  module will be called gt968_update.

config GT968_TOUCHPANEL_UPDATE
	tristate "Goodix GT968 touchpanel auto update support"
	depends on GT968_TOUCHPANEL_DRIVER
	default n
	help
	  This enables support for firmware update for Goodix GT968
	  touchscreens.

	  Say Y here if you have a Goodix GT968 touchscreen connected
	  to your system.

	  If unsure, say N.

	  To compile this driver as a module, choose M here: the
	  module will be called gt968_update.

config GT968_TOUCHPANEL_DEBUG
	tristate "Goodix GT968 Tools for debuging"
	depends on GT968_TOUCHPANEL_DRIVER
	default n
	help
	  This is application debug interface support for Goodix GT968
	  touchscreens.

	  Say Y here if you want to have a Android app debug interface
	  to your system.

	  If unsure, say N.

	  To compile this driver as a module, choose M here: the
	  module will be called gt968_update.
	  
	  
```
