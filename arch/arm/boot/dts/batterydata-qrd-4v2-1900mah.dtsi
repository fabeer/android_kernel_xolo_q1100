/* Copyright (c) 2013, The Linux Foundation. All rights reserved.
 *
 * This program is free software; you can redistribute it and/or modify
 * it under the terms of the GNU General Public License version 2 and
 * only version 2 as published by the Free Software Foundation.
 *
 * This program is distributed in the hope that it will be useful,
 * but WITHOUT ANY WARRANTY; without even the implied warranty of
 * MERCHANTABILITY or FITNESS FOR A PARTICULAR PURPOSE.  See the
 * GNU General Public License for more details.
 */

qcom,qrd-4v2-1900mah-data {
	qcom,fcc-mah = <1900>;
	qcom,default-rbatt-mohm = <146>;
	qcom,rbatt-capacitive-mohm = <0>;
	qcom,flat-ocv-threshold-uv = <3800000>;
	qcom,max-voltage-uv = <4200000>;
	qcom,v-cutoff-uv = <3400000>;
	qcom,chg-term-ua = <100000>;
	qcom,batt-id-kohm = <47>;

	qcom,rbatt-sf-lut {
		qcom,lut-col-legend = <(-20) 0 25 40 60>;
		qcom,lut-row-legend = <100 95 90 85 80>,
				<75 70 65 60 55>,
				<50 45 40 35 30>,
				<25 20 15 10 9>,
				<8 7 6 5 4>,
				<3 2 1 0>;
		qcom,lut-data = <10 10 10 10 10>,
				<89 89 89 89 89>,
				<91 91 91 91 91>,
				<82 82 82 82 82>,
				<94 94 94 94 94>,
				<91 91 91 91 91>,
				<77 77 77 77 77>,
				<90 90 90 90 90>,
				<90 90 90 90 90>,
				<90 90 90 90 90>,
				<90 90 90 90 90>,
				<90 90 90 90 90>,
				<90 90 90 90 90>,
				<90 90 90 90 90>,
				<90 90 90 90 90>,
				<90 90 90 90 90>,
				<90 90 90 90 90>,
				<90 90 90 90 90>,
				<90 90 90 90 90>,
				<90 90 90 90 90>,
				<90 90 90 90 90>,
				<90 90 90 90 90>,
				<90 90 90 90 90>,
				<90 90 90 90 90>,
				<90 90 90 90 90>,
				<90 90 90 90 90>,
				<90 90 90 90 90>,
				<90 90 90 90 90>,
				<90 90 90 90 90>;
	};

	qcom,fcc-temp-lut {
		qcom,lut-col-legend = <(-20) 0 25 40 60>;
		qcom,lut-data = <1959 1968 1973 1961 1959>;
	};

	qcom,pc-temp-ocv-lut {
		qcom,lut-col-legend = <(-20) 0 25 40 60>;
		qcom,lut-row-legend = <100 95 90 85 80>,
				<75 70 65 60 55>,
				<50 45 40 35 30>,
				<25 20 15 10 9>,
				<8 7 6 5 4>,
				<3 2 1 0>;
		qcom,lut-data = 
		              <4180 4180 4180 4180 4180>,
				<4140 4140 4140 4140 4140>,
				<4090 4090 4090 4090 4090>,
				<4052 4052 4052 4052 4052>,
				<3981 3981 3981 3981 3981>,
				<3954 3954 3954 3954 3954>,
				<3908 3908 3908 3908 3908>,
				<3864 3864 3864 3864 3864>,
				<3838 3838 3838 3838 3838>,
				<3817 3817 3817 3817 3817>,
				<3800 3800 3800 3800 3800>,
				<3786 3786 3786 3786 3786>,
				<3774 3774 3774 3774 3774>,
				<3759 3759 3759 3759 3759>,
				<3744 3744 3744 3744 3744>,
				<3726 3726 3726 3726 3726>,
				<3697 3697 3697 3697 3697>,
				<3685 3685 3685 3685 3685>,
				<3618 3618 3618 3618 3618>,
				<3582 3582 3582 3582 3582>,
				<3511 3511 3511 3511 3511>,
				<3408 3408 3408 3408 3408>,
				<3296 3296 3296 3296 3296>,
				<3121 3121 3121 3121 3121>,
				<3083 3083 3083 3083 3083>,
				<3070 3070 3070 3070 3070>,
				<3065 3065 3065 3065 3065>,
				<3061 3061 3061 3061 3061>,
				<3058 3058 3058 3058 3058>;
	};
};
