/* Copyright (c) 2013, The Linux Foundation. All rights reserved.
 *
 * This program is free software; you can redistribute it and/or modify
 * it under the terms of the GNU General Public License version 2 and
 * only version 2 as published by the Free Software Foundation.
 *
 * This program is distributed in the hope that it will be useful,
 * but WITHOUT ANY WARRANTY; without even the implied warranty of
 * MERCHANTABILITY or FITNESS FOR A PARTICULAR PURPOSE.  See the
 * GNU General Public License for more details.
 */

/*---------------------------------------------------------------------------
 * This file is autogenerated file using gcdb parser. Please do not edit it.
 * Update input XML file to add a new entry or update variable in this file
 * VERSION = "1.0"
 *---------------------------------------------------------------------------*/
&mdss_mdp {
	dsi_otm9608a_qhd_vid: qcom,mdss_dsi_otm9608a_qhd_video {
		qcom,mdss-dsi-panel-name = "otm9608a qhd video mode dsi panel";
		qcom,mdss-dsi-panel-controller = <&mdss_dsi0>;
		qcom,mdss-dsi-panel-type = "dsi_video_mode";
		qcom,mdss-dsi-panel-destination = "display_1";
		qcom,mdss-dsi-panel-framerate = <60>;
		qcom,mdss-dsi-virtual-channel-id = <0>;
		qcom,mdss-dsi-stream = <0>;
		qcom,mdss-dsi-panel-width = <540>;
		qcom,mdss-dsi-panel-height = <960>;
		qcom,mdss-dsi-h-front-porch = <127>;
		qcom,mdss-dsi-h-back-porch = <200>;
		qcom,mdss-dsi-h-pulse-width = <32>;
		qcom,mdss-dsi-h-sync-skew = <0>;
		qcom,mdss-dsi-v-back-porch = <15>;
		qcom,mdss-dsi-v-front-porch = <3>;
		qcom,mdss-dsi-v-pulse-width = <10>;
		qcom,mdss-dsi-h-left-border = <0>;
		qcom,mdss-dsi-h-right-border = <0>;
		qcom,mdss-dsi-v-top-border = <0>;
		qcom,mdss-dsi-v-bottom-border = <0>;
		qcom,mdss-dsi-bpp = <24>;
		qcom,mdss-dsi-color-order = <2>;
		qcom,mdss-dsi-underflow-color = <0xff>;
		qcom,mdss-dsi-border-color = <0>;
		qcom,mdss-dsi-pixel-packing = <0>;
		qcom,mdss-dsi-on-command = [39 01 00 00 00 00 02 00 00
					39 01 00 00 00 00 04 ff 96 08 01
					39 01 00 00 00 00 02 00 80
					39 01 00 00 00 00 03 ff 96 08
					39 01 00 00 00 00 02 00 00
					39 01 00 00 00 00 02 a0 00
					39 01 00 00 00 00 02 00 80
					39 01 00 00 00 00 06 b3 00 00 00 21 00
					39 01 00 00 00 00 02 00 92
					39 01 00 00 00 00 02 b3 01
					39 01 00 00 00 00 02 00 c0
					39 01 00 00 00 00 02 b3 19
					39 01 00 00 00 00 02 00 80
					39 01 00 00 00 00 0a c0 00 48 00 10 10 00 47 1F 1F
					39 01 00 00 00 00 02 00 92
					39 01 00 00 00 00 05 c0 00 0E 00 11
					39 01 00 00 00 00 02 00 a2
					39 01 00 00 00 00 04 c0 01 10 00
					39 01 00 00 00 00 02 00 b3
					39 01 00 00 00 00 03 c0 00 50
					39 01 00 00 00 00 02 00 81
					39 01 00 00 00 00 02 c1 55
					39 01 00 00 00 00 02 00 80
					39 01 00 00 00 00 04 c4 00 84 fa
					39 01 00 00 00 00 02 00 a0
					39 01 00 00 00 00 09 c4 33 09 90 2B 33 09 90 54
					39 01 00 00 00 00 02 00 80
					39 01 00 00 00 00 05 c5 08 00 90 11
					39 01 00 00 00 00 02 00 90
					39 01 00 00 00 00 08 c5 84 76 00 76 33 33 34
					39 01 00 00 00 00 02 00 a0
					39 01 00 00 00 00 08 c5 96 76 06 76 33 33 34
					39 01 00 00 00 00 02 00 b0
					39 01 00 00 00 00 03 c5 04 f8
					39 01 00 00 00 00 02 00 80
					39 01 00 00 00 00 02 c6 64
					39 01 00 00 00 00 02 00 b0
					39 01 00 00 00 00 06 c6 03 10 00 1F 12
					39 01 00 00 00 00 02 00 e1
					39 01 00 00 00 00 02 c0 9f
					39 01 00 00 00 00 02 00 00
					39 01 00 00 00 00 02 d0 01
					39 01 00 00 00 00 02 00 00
					39 01 00 00 00 00 03 d1 01 01
					39 01 00 00 00 00 02 00 b7
					39 01 00 00 00 00 02 b0 10
					39 01 00 00 00 00 02 00 c0
					39 01 00 00 00 00 02 b0 55
					39 01 00 00 00 00 02 00 b1
					39 01 00 00 00 00 03 b0 03 06
					39 01 00 00 00 00 02 00 80
					39 01 00 00 00 00 0b cb 00 00 00 00 00 00 00 00 00 00
					39 01 00 00 00 00 02 00 90
					39 01 00 00 00 00 10 cb 00 00 00 00 00 00 00 00 00 00 00 00 00 00 00
					39 01 00 00 00 00 02 00 a0
					39 01 00 00 00 00 10 cb 00 00 00 00 00 00 00 00 00 00 00 00 00 00 00
					39 01 00 00 00 00 02 00 b0
					39 01 00 00 00 00 0b cb 00 00 00 00 00 00 00 00 00 00
					39 01 00 00 00 00 02 00 c0
					39 01 00 00 00 00 10 cb 00 00 04 04 04 04 00 00 04 04 04 04 00 00 00
					39 01 00 00 00 00 02 00 d0
					39 01 00 00 00 00 10 cb 00 00 00 00 00 00 00 04 04 04 04 00 00 04 04
					39 01 00 00 00 00 02 00 e0
					39 01 00 00 00 00 0b cb 04 04 00 00 00 00 00 00 00 00
					39 01 00 00 00 00 02 00 f0
					39 01 00 00 00 00 0b cb FF FF FF FF FF FF FF FF FF FF
					39 01 00 00 00 00 02 00 80
					39 01 00 00 00 00 0b cc 00 00 25 26 02 06 00 00 0A 0E
					39 01 00 00 00 00 02 00 90
					39 01 00 00 00 00 10 cc 0C 10 00 00 00 00 00 00 00 00 00 00 25 26 01
					39 01 00 00 00 00 02 00 a0
					39 01 00 00 00 00 10 cc 05 00 00 09 0D 0B 0F 00 00 00 00 00 00 00 00
					39 01 00 00 00 00 02 00 b0
					39 01 00 00 00 00 0b cc 00 00 26 25 05 01 00 00 0F 0B
					39 01 00 00 00 00 02 00 c0
					39 01 00 00 00 00 10 cc 0D 09 00 00 00 00 00 00 00 00 00 00 26 25 06
					39 01 00 00 00 00 02 00 d0
					39 01 00 00 00 00 10 cc 02 00 00 10 0C 0E 0A 00 00 00 00 00 00 00 00
					39 01 00 00 00 00 02 00 80
					39 01 00 00 00 00 0d ce 86 03 28 85 03 28 00 0F 00 00 0F 00
					39 01 00 00 00 00 02 00 90
					39 01 00 00 00 00 0f ce 33 BF 28 33 C0 28 F0 00 00 F0 00 00 00 00
					39 01 00 00 00 00 02 00 a0
					39 01 00 00 00 00 0f ce 38 02 03 C1 86 18 00 38 01 03 C2 85 18 00
					39 01 00 00 00 00 02 00 b0
					39 01 00 00 00 00 0f ce 38 00 03 C3 86 18 00 30 00 03 C4 85 18 00
					39 01 00 00 00 00 02 00 c0
					39 01 00 00 00 00 0f ce 30 01 03 C5 86 18 00 30 02 03 C6 85 18 00
					39 01 00 00 00 00 02 00 d0
					39 01 00 00 00 00 0f ce 30 03 03 C7 86 18 00 30 04 03 C8 85 18 00
					39 01 00 00 00 00 02 00 80
					39 01 00 00 00 00 0f cf F0 00 00 10 00 00 00 F0 00 00 10 00 00 00
					39 01 00 00 00 00 02 00 90
					39 01 00 00 00 00 0f cf F0 00 00 10 00 00 00 F0 00 00 10 00 00 00
					39 01 00 00 00 00 02 00 a0
					39 01 00 00 00 00 0f cf F0 00 00 10 00 00 00 F0 00 00 10 00 00 00
					39 01 00 00 00 00 02 00 b0
					39 01 00 00 00 00 0f cf F0 00 00 10 00 00 00 F0 00 00 10 00 00 00
					39 01 00 00 00 00 02 00 c0
					39 01 00 00 00 00 0b cf 01 01 20 20 00 00 02 01 00 00
					39 01 00 00 00 00 02 00 80
					39 01 00 00 00 00 02 d6 00
					39 01 00 00 00 00 02 00 00
					39 01 00 00 00 00 02 d7 00
					39 01 00 00 00 00 02 00 00
					39 01 00 00 00 00 03 d8 6f 6f
					39 01 00 00 00 00 02 00 00
					39 01 00 00 00 00 02 d9 21
					39 01 00 00 00 00 02 00 00
					39 01 00 00 00 00 11 e1 09 11 17 0D 06 0E 0A 08 05 09 0D 07 0E 0E 0A 08
					39 01 00 00 00 00 02 00 00
					39 01 00 00 00 00 11 e2 09 11 17 0D 06 0E 0A 08 05 09 0D 07 0E 0E 0A 08
					39 01 00 00 00 00 02 00 00
					39 01 00 00 00 00 04 ff ff ff ff
					39 01 00 00 00 00 02 00 00
					39 01 00 00 00 00 02 3a 77
					39 01 00 00 00 00 02 00 00
					39 01 00 00 00 00 02 21 00
					39 01 00 00 00 00 02 35 00
					39 01 00 00 00 00 02 00 00
					39 01 00 00 96 00 02 11 00
					39 01 00 00 00 00 02 00 00
					39 01 00 00 32 00 02 29 00];
		qcom,mdss-dsi-off-command = [05 01 00 00 0a 00 02 28 00
					05 01 00 00 96 00 02 10 00];
		qcom,mdss-dsi-on-command-state = "dsi_lp_mode";
		qcom,mdss-dsi-off-command-state = "dsi_hs_mode";
		qcom,mdss-dsi-h-sync-pulse = <1>;
		qcom,mdss-dsi-traffic-mode = <2>;
		qcom,mdss-dsi-lane-map = <0>;
		qcom,mdss-dsi-bllp-eof-power-mode;
		qcom,mdss-dsi-bllp-power-mode;
		qcom,mdss-dsi-lane-0-state;
		qcom,mdss-dsi-lane-1-state;
		/*qcom,mdss-dsi-lane-2-state;
		qcom,mdss-dsi-lane-3-state;*/
		qcom,mdss-dsi-panel-timings = [7d 25 1d 00 37 33 22 27 1e 03 04 00];
		qcom,mdss-dsi-t-clk-post = <0x20>;
		qcom,mdss-dsi-t-clk-pre = <0x2D>;
		qcom,mdss-dsi-bl-min-level = <1>;
		qcom,mdss-dsi-bl-max-level = <255>;
		qcom,mdss-dsi-dma-trigger = <4>;
		qcom,mdss-dsi-mdp-trigger = <0>;
		qcom,mdss-pan-bl-levels = <1 255>;
		qcom,mdss-dsi-bl-pmic-control-type = "bl_ctrl_wled";
		qcom,mdss-dsi-reset-sequence = <1 20>, <0 15>, <1 20>;
	};
};

